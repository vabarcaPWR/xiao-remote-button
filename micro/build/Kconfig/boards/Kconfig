## micro/build/Kconfig/boards/Kconfig
```kconfig
# Load Zephyr board Kconfig descriptions.
osource "/home/vabarca/ncs/zephyr/boards/seeed/xiao_ble/Kconfig"
```

## micro/build/Kconfig/boards/Kconfig.defconfig
```kconfig
# Load Zephyr board defconfig descriptions.
osource "/home/vabarca/ncs/zephyr/boards/seeed/xiao_ble/Kconfig.defconfig"
```

## micro/build/Kconfig/boards/Kconfig.sysbuild
```kconfig
# Load Sysbuild board Kconfig descriptions.
osource "/home/vabarca/ncs/zephyr/boards/seeed/xiao_ble/Kconfig.sysbuild"
```

## micro/build/micro/Kconfig/arch/Kconfig
```kconfig
# Load Zephyr Arch Kconfig descriptions.
osource "/home/vabarca/ncs/zephyr/arch/x86/Kconfig"
osource "/home/vabarca/ncs/zephyr/arch/xtensa/Kconfig"
osource "/home/vabarca/ncs/zephyr/arch/sparc/Kconfig"
osource "/home/vabarca/ncs/zephyr/arch/riscv/Kconfig"
osource "/home/vabarca/ncs/zephyr/arch/posix/Kconfig"
osource "/home/vabarca/ncs/zephyr/arch/nios2/Kconfig"
osource "/home/vabarca/ncs/zephyr/arch/mips/Kconfig"
osource "/home/vabarca/ncs/zephyr/arch/arm64/Kconfig"
osource "/home/vabarca/ncs/zephyr/arch/arm/Kconfig"
osource "/home/vabarca/ncs/zephyr/arch/arc/Kconfig"
```
